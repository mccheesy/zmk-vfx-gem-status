## Kconfig
```kconfig
config GEM_STATUS
    bool "Enable Gem custom display for ZMK"

if GEM_STATUS

config GEM_STATUS_DRIVER
    prompt "Gem Display Driver"
    default GEM_STATUS_DRIVER_LS0XX
    help
        Select the display driver for the Gem display module.

config GEM_STATUS_DRIVER_LS0XX
    bool "Nice!View Memory-in-Pixel display (ls0xx)"

config GEM_STATUS_DRIVER_ST7735R
    bool "ST7735R TFT Display"

if GEM_STATUS_DRIVER_LS0XX

config LV_Z_VDB_SIZE
    default 100

config LV_DPI_DEF
    default 161

config LV_Z_BITS_PER_PIXEL
    default 1

choice LV_COLOR_DEPTH
    default LV_COLOR_DEPTH_1
endchoice

elif GEM_STATUS_DRIVER_ST7735R

config LV_Z_VDB_SIZE
    default 64

config LV_DPI_DEF
    default 148

config LV_Z_BITS_PER_PIXEL
    default 16

choice LV_COLOR_DEPTH
    default LV_COLOR_DEPTH_16
endchoice

endif # GEM_STATUS_DRIVER_LS0XX or GEM_STATUS_DRIVER_ST7735R

choice ZMK_DISPLAY_WORK_QUEUE
    default ZMK_DISPLAY_WORK_QUEUE_DEDICATED
endchoice

choice ZMK_DISPLAY_STATUS_SCREEN
    default ZMK_DISPLAY_STATUS_SCREEN_CUSTOM
endchoice

config LV_Z_MEM_POOL_SIZE
    default 4096 if ZMK_DISPLAY_STATUS_SCREEN_CUSTOM

config ZMK_DISPLAY_STATUS_SCREEN_CUSTOM
    imply GEM_STATUS

config GEM_STATUS_WPM_FIXED_RANGE
    bool "Enable fixed range for WPM gauge/chart"
    default y

config GEM_STATUS_WPM_FIXED_RANGE_MAX
    int "Fixed range maximum for WPM gauge/chart"
    default 100

config GEM_STATUS_ANIMATION
    bool "Enable animation on peripheral"
    default y

config GEM_STATUS_ANIMATION_MS
    int "Animation length in milliseconds"
    default 960

config GEM_STATUS_WIDGET_STATUS
    select LV_USE_LABEL
    select LV_USE_IMG
    select LV_USE_CANVAS
    select LV_USE_ANIMIMG
    select LV_USE_ANIMATION

config GEM_STATUS_WIDGET_INVERTED
    bool "Invert display colors"

if !ZMK_SPLIT || ZMK_SPLIT_ROLE_CENTRAL

config GEM_STATUS_WIDGET_STATUS
    select ZMK_WPM

endif # !ZMK_SPLIT || ZMK_SPLIT_ROLE_CENTRAL

endif # GEM_STATUS
```
